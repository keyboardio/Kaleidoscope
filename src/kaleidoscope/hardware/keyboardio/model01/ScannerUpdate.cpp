/* -*- mode: c++ -*-
 * Kaleidoscope-Hardware-Model01 -- Keyboard.io Model01 hardware support for Kaleidoscope
 * Copyright (C) 2017-2018  Keyboard.io, Inc
 *
 * This program is free software: you can redistribute it and/or modify it under
 * the terms of the GNU General Public License as published by the Free Software
 * Foundation, version 3.
 *
 * This program is distributed in the hope that it will be useful, but WITHOUT
 * ANY WARRANTY; without even the implied warranty of MERCHANTABILITY or FITNESS
 * FOR A PARTICULAR PURPOSE. See the GNU General Public License for more
 * details.
 *
 * You should have received a copy of the GNU General Public License along with
 * this program. If not, see <http://www.gnu.org/licenses/>.
 */

// The firmware we use to update the ATTinys with is:
//   https://github.com/keyboardio/avr_keyscanner/tree/9bc65bdd5c010879734b00f43f6edeadefe4f761

#ifdef ARDUINO_AVR_MODEL01

#include <Arduino.h>

#include <util/crc16.h>
extern "C" {
#include <twi.h>
};
#include <avr/wdt.h>

#include "ScannerUpdate.h"

namespace kaleidoscope {
namespace hardware {
namespace keyboardio {
namespace model01 {

#define DELAY 1

#define LEFT_ADDRESS 0x50
#define RIGHT_ADDRESS 0x53

#define ELEMENTS(arr)  (sizeof(arr) / sizeof((arr)[0]))

#define ENDTRANS_SUCCESS 0
#define ENDTRANS_DATA_TOO_LONG 1
#define ENDTRANS_ADDR_NACK 2
#define ENDTRANS_DATA_NACK 3
#define ENDTRANS_ERROR 4

// { Compiled firmware...

#define page_size 64
#define frame_size 16
#define blank 0xff
#define pages 39
#define firmware_length 2496

static uint16_t offsets[pages] = {
  0, 64, 128, 192, 256, 320, 384, 448, 512, 576, 640, 704, 768, 832, 896, 960,
  1024, 1088, 1152, 1216, 1280, 1344, 1408, 1472, 1536, 1600, 1664, 1728, 1792,
  1856, 1920, 1984, 2048, 2112, 2176, 2240, 2304, 2368, 2432
};

static const byte firmware[firmware_length] PROGMEM = {
  0x1a, 0xc0, 0x34, 0xc0, 0x33, 0xc0, 0x32, 0xc0, 0x31, 0xc0, 0x30, 0xc0, 0x2f, 0xc0, 0x2e, 0xc0,
  0x2d, 0xc0, 0xe7, 0xc1, 0x2b, 0xc0, 0x2a, 0xc0, 0x29, 0xc0, 0x28, 0xc0, 0x27, 0xc0, 0x7f, 0xc1,
  0x25, 0xc0, 0x24, 0xc0, 0x23, 0xc0, 0xec, 0xc1, 0xd8, 0xc0, 0xe3, 0xc0, 0xe2, 0xc0, 0xd5, 0xc0,
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  0xff, 0xff, 0xff, 0xff, 0xff, 0xff, 0xff, 0xff, 0xff, 0xff, 0xff, 0xff, 0xff, 0xff, 0xff, 0xff
};

// } // Compiled firmware

// The LEFT ATTiny has a reset pin directly connected to the ATMega
void ScannerUpdate::reset_left_attiny() {
  // Hold the left ATTiny in reset,
  DDRC |= _BV(6);
  PORTC &= ~_BV(6);
  delay(30);
  DDRC &= ~_BV(6); // Turn the ATTiny back on
}

// The RIGHT ATTiny is on the other side of the wired i2c bus.
// Our best chance at resetting it is by toggling the current limiter.
void ScannerUpdate::reset_right_attiny() {
  // Hold the left ATTiny in reset,
  DDRC |= _BV(7);
  PORTC &= ~_BV(7);
  delay(1000);
  PORTC |= _BV(7); // Turn the ATTiny back on
}

uint8_t ScannerUpdate::read_crc16(byte addr, byte *version,
                                  uint16_t *crc16, uint16_t offset,
                                  uint16_t length) {
  uint8_t result = ENDTRANS_ADDR_NACK;

  // get version and CRC16 // addr (lo) // addr (hi) // len (lo) // len (hi)
  uint8_t data[] = {
    (0x06),
    (uint8_t)(offset & 0xff), (uint8_t)(offset >> 8),
    (uint8_t)(length & 0xff), (uint8_t)(length >> 8)
  };
  result = twi_writeTo(addr, data, ELEMENTS(data), true, true);

  if (result != ENDTRANS_SUCCESS) {
    return result;
  }

  uint8_t rxBuffer[3];

  // perform blocking read into buffer
  uint8_t read = twi_readFrom(addr, rxBuffer, ELEMENTS(rxBuffer), true);
  if (read < ENDTRANS_DATA_NACK) {
    return 0xFF;
  }

  uint8_t v = rxBuffer[0];
  *version = v;
  uint8_t crc16_lo = rxBuffer[1];
  uint8_t crc16_hi = rxBuffer[2];
  *crc16 = (crc16_hi << 8) | crc16_lo;

  return result;
}

void ScannerUpdate::get_version(byte addr) {
  byte result = ENDTRANS_ADDR_NACK;
  while (result != ENDTRANS_SUCCESS) {
    byte version;
    uint16_t crc16;
    result = read_crc16(addr, &version, &crc16, 0, firmware_length);

    if (result != ENDTRANS_SUCCESS) {
      _delay_ms(100);
      continue;
    }
  }
}

int ScannerUpdate::erase_program(uint8_t addr) {
  // erase user space
  uint8_t data[] = { 0x04 };
  uint8_t result = twi_writeTo(addr, data, ELEMENTS(data), true, true);

  if (result != ENDTRANS_SUCCESS) {
    _delay_ms(1000);
    return -1;
  }
  return 0;
}

int ScannerUpdate::write_firmware(uint8_t addr) {
  uint8_t result = ENDTRANS_DATA_NACK;
  uint8_t o = 0;

  for (uint16_t i = 0; i < firmware_length; i += page_size) {
    // write page addr
    uint8_t data[] = {
      0x01,
      (uint8_t)(offsets[o] & 0xff),
      (uint8_t)(offsets[o] >> 8)
    };
    result = twi_writeTo(addr, data, ELEMENTS(data), true, true);

    _delay_ms(DELAY);
    // got something other than ACK. Start over.
    if (result != ENDTRANS_SUCCESS) {
      return -1;
    }

    // transmit each frame separately
    for (uint8_t frame = 0; frame < page_size / frame_size; frame++) {
      uint8_t data_counter = 0;
      uint8_t data[frame_size + 4] = {0};
      data[data_counter++] = 0x2; // continue page
      uint16_t crc16 = 0xffff;
      for (uint8_t j = frame * frame_size; j < (frame + 1) * frame_size; j++) {
        if (i + j < firmware_length) {
          uint8_t b = pgm_read_byte(&firmware[i + j]);
          data[data_counter++] = b;
          crc16 = _crc16_update(crc16, b);
        } else {
          data[data_counter++] = blank;
          crc16 = _crc16_update(crc16, blank);
        }
      }
      // write the CRC16, little end first
      data[data_counter++] = (uint8_t)(crc16 & 0xff);
      data[data_counter++] = (uint8_t)(crc16 >> 8);
      data[data_counter++] = (0x00); // dummy end uint8_t

      result = twi_writeTo(addr, data, ELEMENTS(data), true, true);
      // got something other than NACK. Start over.
      if (result != ENDTRANS_DATA_NACK) {
        return -1;
      }
      delay(DELAY);
    }
    o++;
  }
  return 0;
}

int ScannerUpdate::verify_firmware(byte addr) {
  byte result = ENDTRANS_DATA_NACK;
  while (result != ENDTRANS_SUCCESS) {
    byte version;
    uint16_t crc16;
    // skip the first 4 bytes, are they were probably overwritten by the reset vector preservation
    result = read_crc16(addr, &version, &crc16, offsets[0] + 4, firmware_length - 4);

    if (result != ENDTRANS_SUCCESS) {
      _delay_ms(100);
      continue;
    }

    // calculate our own CRC16
    uint16_t check_crc16 = 0xffff;
    for (uint16_t i = 4; i < firmware_length; i++) {
      check_crc16 = _crc16_update(check_crc16, pgm_read_byte(&firmware[i]));
    }
    if (crc16 != check_crc16) {
      return -1;
    }
  }
  return 0;
}

byte ScannerUpdate::update_attiny(byte addr) {
  get_version(addr);

  int erased = erase_program(addr);

  if (erased == -1) {

    return 0;
  }

  int firmware_written = write_firmware(addr);
  if (firmware_written == -1) {
    return 0;
  }

  int firmware_verified = verify_firmware(addr);
  if (firmware_verified == -1) {
    return 0;
  }

  // execute app
  uint8_t data[] = {0x03, 0x00};
  uint8_t result = twi_writeTo(addr, data, ELEMENTS(data), true, true);

  return 1;
}

void ScannerUpdate::update() {
  Serial.println(F("Updating the ATTiny firmwares..."));

  reset_left_attiny();
  if (update_attiny(LEFT_ADDRESS) == 0) {
    Serial.println(F("Updating the left side failed!"));
    return;
  }

  delay(2000);

  reset_right_attiny();
  if (update_attiny(RIGHT_ADDRESS) == 0) {
    Serial.println(F("Updating the right side failed!"));
    return;
  }

  Serial.println(F("Update successful!"));

  delay(5000);

  // reset the firmware
  wdt_enable(WDTO_120MS);
  while (1) {} // This infinite loop ensures nothing else
  // happens before the watchdog reboots us
}

}
}
}
}
#endif
