// -*- c++ -*-

namespace kaleidoscope {
namespace testing {
namespace keymap {

// Layer 0
constexpr Key key_0AA = Keymap::key_0AA;
constexpr Key key_0AB = Keymap::key_0AB;
constexpr Key key_0AC = Keymap::key_0AC;
constexpr Key key_0AD = Keymap::key_0AD;
constexpr Key key_0AE = Keymap::key_0AE;
constexpr Key key_0AF = Keymap::key_0AF;
constexpr Key key_0AG = Keymap::key_0AG;
constexpr Key key_0AH = Keymap::key_0AH;
constexpr Key key_0AI = Keymap::key_0AI;
constexpr Key key_0AJ = Keymap::key_0AJ;
constexpr Key key_0AK = Keymap::key_0AK;
constexpr Key key_0AL = Keymap::key_0AL;
constexpr Key key_0AM = Keymap::key_0AM;
constexpr Key key_0AN = Keymap::key_0AN;
constexpr Key key_0AO = Keymap::key_0AO;
constexpr Key key_0AP = Keymap::key_0AP;
constexpr Key key_0BA = Keymap::key_0BA;
constexpr Key key_0BB = Keymap::key_0BB;
constexpr Key key_0BC = Keymap::key_0BC;
constexpr Key key_0BD = Keymap::key_0BD;
constexpr Key key_0BE = Keymap::key_0BE;
constexpr Key key_0BF = Keymap::key_0BF;
constexpr Key key_0BG = Keymap::key_0BG;
constexpr Key key_0BH = Keymap::key_0BH;
constexpr Key key_0BI = Keymap::key_0BI;
constexpr Key key_0BJ = Keymap::key_0BJ;
constexpr Key key_0BK = Keymap::key_0BK;
constexpr Key key_0BL = Keymap::key_0BL;
constexpr Key key_0BM = Keymap::key_0BM;
constexpr Key key_0BN = Keymap::key_0BN;
constexpr Key key_0BO = Keymap::key_0BO;
constexpr Key key_0BP = Keymap::key_0BP;
constexpr Key key_0CA = Keymap::key_0CA;
constexpr Key key_0CB = Keymap::key_0CB;
constexpr Key key_0CC = Keymap::key_0CC;
constexpr Key key_0CD = Keymap::key_0CD;
constexpr Key key_0CE = Keymap::key_0CE;
constexpr Key key_0CF = Keymap::key_0CF;
constexpr Key key_0CG = Keymap::key_0CG;
constexpr Key key_0CH = Keymap::key_0CH;
constexpr Key key_0CI = Keymap::key_0CI;
constexpr Key key_0CJ = Keymap::key_0CJ;
constexpr Key key_0CK = Keymap::key_0CK;
constexpr Key key_0CL = Keymap::key_0CL;
constexpr Key key_0CM = Keymap::key_0CM;
constexpr Key key_0CN = Keymap::key_0CN;
constexpr Key key_0CO = Keymap::key_0CO;
constexpr Key key_0CP = Keymap::key_0CP;
constexpr Key key_0DA = Keymap::key_0DA;
constexpr Key key_0DB = Keymap::key_0DB;
constexpr Key key_0DC = Keymap::key_0DC;
constexpr Key key_0DD = Keymap::key_0DD;
constexpr Key key_0DE = Keymap::key_0DE;
constexpr Key key_0DF = Keymap::key_0DF;
constexpr Key key_0DG = Keymap::key_0DG;
constexpr Key key_0DH = Keymap::key_0DH;
constexpr Key key_0DI = Keymap::key_0DI;
constexpr Key key_0DJ = Keymap::key_0DJ;
constexpr Key key_0DK = Keymap::key_0DK;
constexpr Key key_0DL = Keymap::key_0DL;
constexpr Key key_0DM = Keymap::key_0DM;
constexpr Key key_0DN = Keymap::key_0DN;
constexpr Key key_0DO = Keymap::key_0DO;
constexpr Key key_0DP = Keymap::key_0DP;
// Layer 1                             
constexpr Key key_1AA = Keymap::key_1AA;
constexpr Key key_1AB = Keymap::key_1AB;
constexpr Key key_1AC = Keymap::key_1AC;
constexpr Key key_1AD = Keymap::key_1AD;
constexpr Key key_1AE = Keymap::key_1AE;
constexpr Key key_1AF = Keymap::key_1AF;
constexpr Key key_1AG = Keymap::key_1AG;
constexpr Key key_1AH = Keymap::key_1AH;
constexpr Key key_1AI = Keymap::key_1AI;
constexpr Key key_1AJ = Keymap::key_1AJ;
constexpr Key key_1AK = Keymap::key_1AK;
constexpr Key key_1AL = Keymap::key_1AL;
constexpr Key key_1AM = Keymap::key_1AM;
constexpr Key key_1AN = Keymap::key_1AN;
constexpr Key key_1AO = Keymap::key_1AO;
constexpr Key key_1AP = Keymap::key_1AP;
constexpr Key key_1BA = Keymap::key_1BA;
constexpr Key key_1BB = Keymap::key_1BB;
constexpr Key key_1BC = Keymap::key_1BC;
constexpr Key key_1BD = Keymap::key_1BD;
constexpr Key key_1BE = Keymap::key_1BE;
constexpr Key key_1BF = Keymap::key_1BF;
constexpr Key key_1BG = Keymap::key_1BG;
constexpr Key key_1BH = Keymap::key_1BH;
constexpr Key key_1BI = Keymap::key_1BI;
constexpr Key key_1BJ = Keymap::key_1BJ;
constexpr Key key_1BK = Keymap::key_1BK;
constexpr Key key_1BL = Keymap::key_1BL;
constexpr Key key_1BM = Keymap::key_1BM;
constexpr Key key_1BN = Keymap::key_1BN;
constexpr Key key_1BO = Keymap::key_1BO;
constexpr Key key_1BP = Keymap::key_1BP;
constexpr Key key_1CA = Keymap::key_1CA;
constexpr Key key_1CB = Keymap::key_1CB;
constexpr Key key_1CC = Keymap::key_1CC;
constexpr Key key_1CD = Keymap::key_1CD;
constexpr Key key_1CE = Keymap::key_1CE;
constexpr Key key_1CF = Keymap::key_1CF;
constexpr Key key_1CG = Keymap::key_1CG;
constexpr Key key_1CH = Keymap::key_1CH;
constexpr Key key_1CI = Keymap::key_1CI;
constexpr Key key_1CJ = Keymap::key_1CJ;
constexpr Key key_1CK = Keymap::key_1CK;
constexpr Key key_1CL = Keymap::key_1CL;
constexpr Key key_1CM = Keymap::key_1CM;
constexpr Key key_1CN = Keymap::key_1CN;
constexpr Key key_1CO = Keymap::key_1CO;
constexpr Key key_1CP = Keymap::key_1CP;
constexpr Key key_1DA = Keymap::key_1DA;
constexpr Key key_1DB = Keymap::key_1DB;
constexpr Key key_1DC = Keymap::key_1DC;
constexpr Key key_1DD = Keymap::key_1DD;
constexpr Key key_1DE = Keymap::key_1DE;
constexpr Key key_1DF = Keymap::key_1DF;
constexpr Key key_1DG = Keymap::key_1DG;
constexpr Key key_1DH = Keymap::key_1DH;
constexpr Key key_1DI = Keymap::key_1DI;
constexpr Key key_1DJ = Keymap::key_1DJ;
constexpr Key key_1DK = Keymap::key_1DK;
constexpr Key key_1DL = Keymap::key_1DL;
constexpr Key key_1DM = Keymap::key_1DM;
constexpr Key key_1DN = Keymap::key_1DN;
constexpr Key key_1DO = Keymap::key_1DO;
constexpr Key key_1DP = Keymap::key_1DP;
// Layer 2                             
constexpr Key key_2AA = Keymap::key_2AA;
constexpr Key key_2AB = Keymap::key_2AB;
constexpr Key key_2AC = Keymap::key_2AC;
constexpr Key key_2AD = Keymap::key_2AD;
constexpr Key key_2AE = Keymap::key_2AE;
constexpr Key key_2AF = Keymap::key_2AF;
constexpr Key key_2AG = Keymap::key_2AG;
constexpr Key key_2AH = Keymap::key_2AH;
constexpr Key key_2AI = Keymap::key_2AI;
constexpr Key key_2AJ = Keymap::key_2AJ;
constexpr Key key_2AK = Keymap::key_2AK;
constexpr Key key_2AL = Keymap::key_2AL;
constexpr Key key_2AM = Keymap::key_2AM;
constexpr Key key_2AN = Keymap::key_2AN;
constexpr Key key_2AO = Keymap::key_2AO;
constexpr Key key_2AP = Keymap::key_2AP;
constexpr Key key_2BA = Keymap::key_2BA;
constexpr Key key_2BB = Keymap::key_2BB;
constexpr Key key_2BC = Keymap::key_2BC;
constexpr Key key_2BD = Keymap::key_2BD;
constexpr Key key_2BE = Keymap::key_2BE;
constexpr Key key_2BF = Keymap::key_2BF;
constexpr Key key_2BG = Keymap::key_2BG;
constexpr Key key_2BH = Keymap::key_2BH;
constexpr Key key_2BI = Keymap::key_2BI;
constexpr Key key_2BJ = Keymap::key_2BJ;
constexpr Key key_2BK = Keymap::key_2BK;
constexpr Key key_2BL = Keymap::key_2BL;
constexpr Key key_2BM = Keymap::key_2BM;
constexpr Key key_2BN = Keymap::key_2BN;
constexpr Key key_2BO = Keymap::key_2BO;
constexpr Key key_2BP = Keymap::key_2BP;
constexpr Key key_2CA = Keymap::key_2CA;
constexpr Key key_2CB = Keymap::key_2CB;
constexpr Key key_2CC = Keymap::key_2CC;
constexpr Key key_2CD = Keymap::key_2CD;
constexpr Key key_2CE = Keymap::key_2CE;
constexpr Key key_2CF = Keymap::key_2CF;
constexpr Key key_2CG = Keymap::key_2CG;
constexpr Key key_2CH = Keymap::key_2CH;
constexpr Key key_2CI = Keymap::key_2CI;
constexpr Key key_2CJ = Keymap::key_2CJ;
constexpr Key key_2CK = Keymap::key_2CK;
constexpr Key key_2CL = Keymap::key_2CL;
constexpr Key key_2CM = Keymap::key_2CM;
constexpr Key key_2CN = Keymap::key_2CN;
constexpr Key key_2CO = Keymap::key_2CO;
constexpr Key key_2CP = Keymap::key_2CP;
constexpr Key key_2DA = Keymap::key_2DA;
constexpr Key key_2DB = Keymap::key_2DB;
constexpr Key key_2DC = Keymap::key_2DC;
constexpr Key key_2DD = Keymap::key_2DD;
constexpr Key key_2DE = Keymap::key_2DE;
constexpr Key key_2DF = Keymap::key_2DF;
constexpr Key key_2DG = Keymap::key_2DG;
constexpr Key key_2DH = Keymap::key_2DH;
constexpr Key key_2DI = Keymap::key_2DI;
constexpr Key key_2DJ = Keymap::key_2DJ;
constexpr Key key_2DK = Keymap::key_2DK;
constexpr Key key_2DL = Keymap::key_2DL;
constexpr Key key_2DM = Keymap::key_2DM;
constexpr Key key_2DN = Keymap::key_2DN;
constexpr Key key_2DO = Keymap::key_2DO;
constexpr Key key_2DP = Keymap::key_2DP;
// Layer 3                             
constexpr Key key_3AA = Keymap::key_3AA;
constexpr Key key_3AB = Keymap::key_3AB;
constexpr Key key_3AC = Keymap::key_3AC;
constexpr Key key_3AD = Keymap::key_3AD;
constexpr Key key_3AE = Keymap::key_3AE;
constexpr Key key_3AF = Keymap::key_3AF;
constexpr Key key_3AG = Keymap::key_3AG;
constexpr Key key_3AH = Keymap::key_3AH;
constexpr Key key_3AI = Keymap::key_3AI;
constexpr Key key_3AJ = Keymap::key_3AJ;
constexpr Key key_3AK = Keymap::key_3AK;
constexpr Key key_3AL = Keymap::key_3AL;
constexpr Key key_3AM = Keymap::key_3AM;
constexpr Key key_3AN = Keymap::key_3AN;
constexpr Key key_3AO = Keymap::key_3AO;
constexpr Key key_3AP = Keymap::key_3AP;
constexpr Key key_3BA = Keymap::key_3BA;
constexpr Key key_3BB = Keymap::key_3BB;
constexpr Key key_3BC = Keymap::key_3BC;
constexpr Key key_3BD = Keymap::key_3BD;
constexpr Key key_3BE = Keymap::key_3BE;
constexpr Key key_3BF = Keymap::key_3BF;
constexpr Key key_3BG = Keymap::key_3BG;
constexpr Key key_3BH = Keymap::key_3BH;
constexpr Key key_3BI = Keymap::key_3BI;
constexpr Key key_3BJ = Keymap::key_3BJ;
constexpr Key key_3BK = Keymap::key_3BK;
constexpr Key key_3BL = Keymap::key_3BL;
constexpr Key key_3BM = Keymap::key_3BM;
constexpr Key key_3BN = Keymap::key_3BN;
constexpr Key key_3BO = Keymap::key_3BO;
constexpr Key key_3BP = Keymap::key_3BP;
constexpr Key key_3CA = Keymap::key_3CA;
constexpr Key key_3CB = Keymap::key_3CB;
constexpr Key key_3CC = Keymap::key_3CC;
constexpr Key key_3CD = Keymap::key_3CD;
constexpr Key key_3CE = Keymap::key_3CE;
constexpr Key key_3CF = Keymap::key_3CF;
constexpr Key key_3CG = Keymap::key_3CG;
constexpr Key key_3CH = Keymap::key_3CH;
constexpr Key key_3CI = Keymap::key_3CI;
constexpr Key key_3CJ = Keymap::key_3CJ;
constexpr Key key_3CK = Keymap::key_3CK;
constexpr Key key_3CL = Keymap::key_3CL;
constexpr Key key_3CM = Keymap::key_3CM;
constexpr Key key_3CN = Keymap::key_3CN;
constexpr Key key_3CO = Keymap::key_3CO;
constexpr Key key_3CP = Keymap::key_3CP;
constexpr Key key_3DA = Keymap::key_3DA;
constexpr Key key_3DB = Keymap::key_3DB;
constexpr Key key_3DC = Keymap::key_3DC;
constexpr Key key_3DD = Keymap::key_3DD;
constexpr Key key_3DE = Keymap::key_3DE;
constexpr Key key_3DF = Keymap::key_3DF;
constexpr Key key_3DG = Keymap::key_3DG;
constexpr Key key_3DH = Keymap::key_3DH;
constexpr Key key_3DI = Keymap::key_3DI;
constexpr Key key_3DJ = Keymap::key_3DJ;
constexpr Key key_3DK = Keymap::key_3DK;
constexpr Key key_3DL = Keymap::key_3DL;
constexpr Key key_3DM = Keymap::key_3DM;
constexpr Key key_3DN = Keymap::key_3DN;
constexpr Key key_3DO = Keymap::key_3DO;
constexpr Key key_3DP = Keymap::key_3DP;

}  // namespace keymap
}  // namespace testing
}  // namespace kaleidoscope
